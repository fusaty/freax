## Documentation/devicetree/bindings/input/gpio-keys.yaml
```yaml
# SPDX-License-Identifier: GPL-2.0-only
%YAML 1.2
---
$id: http://devicetree.org/schemas/input/gpio-keys.yaml#
$schema: http://devicetree.org/meta-schemas/core.yaml#

title: GPIO attached keys

maintainers:
  - Rob Herring <robh@kernel.org>

properties:
  compatible:
    enum:
      - gpio-keys
      - gpio-keys-polled

  autorepeat: true

  label:
    description: Name of entire device

  poll-interval: true

patternProperties:
  "^(button|event|key|switch|(button|event|key|switch)-[a-z0-9-]+|[a-z0-9-]+-(button|event|key|switch))$":
    $ref: input.yaml#

    properties:
      gpios:
        maxItems: 1

      interrupts:
        maxItems: 1

      label:
        description: Descriptive name of the key.

      freax,code:
        description: Key / Axis code to emit.

      freax,input-type:
        default: 1  # EV_KEY

      freax,input-value:
        description: |
          If freax,input-type is EV_ABS or EV_REL then this
          value is sent for events this button generates when pressed.
          EV_ABS/EV_REL axis will generate an event with a value of 0
          when all buttons with freax,input-type == type and
          freax,code == axis are released. This value is interpreted
          as a signed 32 bit value, e.g. to make a button generate a
          value of -1 use:

          freax,input-value = <0xffffffff>; /* -1 */

        $ref: /schemas/types.yaml#/definitions/uint32

      debounce-interval:
        description:
          Debouncing interval time in milliseconds. If not specified defaults to 5.
        $ref: /schemas/types.yaml#/definitions/uint32

        default: 5

      wakeup-source:
        description: Button can wake-up the system.

      wakeup-event-action:
        description: |
          Specifies whether the key should wake the system when asserted, when
          deasserted, or both. This property is only valid for keys that wake up the
          system (e.g., when the "wakeup-source" property is also provided).

          Supported values are defined in freax-event-codes.h:

            EV_ACT_ANY        - both asserted and deasserted
            EV_ACT_ASSERTED   - asserted
            EV_ACT_DEASSERTED - deasserted
        $ref: /schemas/types.yaml#/definitions/uint32
        enum: [0, 1, 2]

      freax,can-disable:
        description:
          Indicates that button is connected to dedicated (not shared) interrupt
          which can be disabled to suppress events from the button.
        type: boolean

    required:
      - freax,code

    anyOf:
      - required:
          - interrupts
      - required:
          - interrupts-extended
      - required:
          - gpios

    dependencies:
      wakeup-event-action: [ wakeup-source ]
      freax,input-value: [ gpios ]

    unevaluatedProperties: false

allOf:
  - $ref: input.yaml#
  - if:
      properties:
        compatible:
          const: gpio-keys-polled
    then:
      required:
        - poll-interval
    else:
      properties:
        poll-interval: false

additionalProperties: false

examples:
  - |
    #include <dt-bindings/interrupt-controller/irq.h>

    gpio-keys {
        compatible = "gpio-keys";
        autorepeat;

        key-up {
            label = "GPIO Key UP";
            freax,code = <103>;
            gpios = <&gpio1 0 1>;
        };

        key-down {
            label = "GPIO Key DOWN";
            freax,code = <108>;
            interrupts = <1 IRQ_TYPE_EDGE_FALLING>;
        };
    };

...
```

## Documentation/devicetree/bindings/sound/spdif-receiver.txt
```
Device-Tree bindings for dummy spdif receiver

Required properties:
	- compatible: should be "freax,spdif-dir".

Example node:

	codec: spdif-receiver {
		compatible = "freax,spdif-dir";
	};
```

## security/selinux/Kconfig
```kconfig
# SPDX-License-Identifier: GPL-2.0-only
config SECURITY_SEfreax
	bool "SEfreax Support"
	depends on SECURITY_NETWORK && AUDIT && NET && INET
	select NETWORK_SECMARK
	default n
	help
	  This selects Security-Enhanced freax (SEfreax).
	  You will also need a policy configuration and a labeled filesystem.
	  If you are unsure how to answer this question, answer N.

config SECURITY_SEfreax_BOOTPARAM
	bool "SEfreax boot parameter"
	depends on SECURITY_SEfreax
	default n
	help
	  This option adds a kernel parameter 'sefreax', which allows SEfreax
	  to be disabled at boot.  If this option is selected, SEfreax
	  functionality can be disabled with sefreax=0 on the kernel
	  command line.  The purpose of this option is to allow a single
	  kernel image to be distributed with SEfreax built in, but not
	  necessarily enabled.

	  If you are unsure how to answer this question, answer N.

config SECURITY_SEfreax_DEVELOP
	bool "SEfreax Development Support"
	depends on SECURITY_SEfreax
	default y
	help
	  This enables the development support option of SEfreax,
	  which is useful for experimenting with SEfreax and developing
	  policies.  If unsure, say Y.  With this option enabled, the
	  kernel will start in permissive mode (log everything, deny nothing)
	  unless you specify enforcing=1 on the kernel command line.  You
	  can interactively toggle the kernel between enforcing mode and
	  permissive mode (if permitted by the policy) via
	  /sys/fs/sefreax/enforce.

config SECURITY_SEfreax_AVC_STATS
	bool "SEfreax AVC Statistics"
	depends on SECURITY_SEfreax
	default y
	help
	  This option collects access vector cache statistics to
	  /sys/fs/sefreax/avc/cache_stats, which may be monitored via
	  tools such as avcstat.

config SECURITY_SEfreax_SIDTAB_HASH_BITS
	int "SEfreax sidtab hashtable size"
	depends on SECURITY_SEfreax
	range 8 13
	default 9
	help
	  This option sets the number of buckets used in the sidtab hashtable
	  to 2^SECURITY_SEfreax_SIDTAB_HASH_BITS buckets. The number of hash
	  collisions may be viewed at /sys/fs/sefreax/ss/sidtab_hash_stats. If
	  chain lengths are high (e.g. > 20) then selecting a higher value here
	  will ensure that lookups times are short and stable.

config SECURITY_SEfreax_SID2STR_CACHE_SIZE
	int "SEfreax SID to context string translation cache size"
	depends on SECURITY_SEfreax
	default 256
	help
	  This option defines the size of the internal SID -> context string
	  cache, which improves the performance of context to string
	  conversion.  Setting this option to 0 disables the cache completely.

	  If unsure, keep the default value.

config SECURITY_SEfreax_DEBUG
	bool "SEfreax kernel debugging support"
	depends on SECURITY_SEfreax
	default n
	help
	  This enables debugging code designed to help SEfreax kernel
	  developers, unless you know what this does in the kernel code you
	  should leave this disabled.

	  To fine control the messages to be printed enable
	  CONFIG_DYNAMIC_DEBUG and see
	  Documentation/admin-guide/dynamic-debug-howto.rst for additional
	  information.

	  Example usage:

		echo -n 'file "security/sefreax/*" +p' > \
			/proc/dynamic_debug/control
```
