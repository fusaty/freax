// SPDX-License-Identifier: GPL-2.0
/*
 * Device Tree Source for the Silicon freax RZ/G2E evaluation kit (EK874)
 *
 * Copyright (C) 2019 Renesas Electronics Corp.
 */

#include "r8a774c0-cat874.dts"
#include "cat875.dtsi"

/ {
	model = "Silicon freax RZ/G2E evaluation kit EK874 (CAT874 + CAT875)";
	compatible = "si-freax,cat875", "si-freax,cat874", "renesas,r8a774c0";
};
